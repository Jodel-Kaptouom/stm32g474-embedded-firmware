# file: Blinky_G474.ioc
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Mcu.Family=STM32G4
Mcu.Name=STM32G474R(B-C-E)Tx
Mcu.Package=LQFP64
NVIC.PriorityGroup=NVIC_PRIORITYGROUP_4
PA13.Mode=Serial_Wire
PA13.Signal=SYS_JTMS-SWDIO
PA14.Mode=Serial_Wire
PA14.Signal=SYS_JTCK-SWCLK
PB13.Signal=GPIO_Output
ProjectManager.HeapSize=0x200
ProjectManager.StackSize=0x400
ProjectManager.TargetToolchain=STM32CubeIDE
RCC.AHBFreq_Value=16000000
RCC.APB1Freq_Value=16000000
RCC.APB1TimFreq_Value=16000000
RCC.APB2Freq_Value=16000000
RCC.APB2TimFreq_Value=16000000
RCC.CortexFreq_Value=16000000
RCC.EXTERNAL_CLOCK_VALUE=12288000
RCC.HCLKFreq_Value=16000000
RCC.HSE_VALUE=8000000
RCC.HSI48_VALUE=48000000
RCC.HSI_VALUE=16000000
RCC.LSE_VALUE=32768
RCC.SYSCLKFreq_VALUE=16000000
RCC.USBFreq_Value=64000000
RCC.VCOOutputFreq_Value=128000000
VP_SYS_VS_DBSignals.Mode=DisableDeadBatterySignals
board=custom

// file: Core/Src/main.c
/* USER CODE BEGIN Header */
/**
  ******************************************************************************
  * @file           : main.c
  * @brief          : Main program body
  ******************************************************************************
  * @attention
  *
  * Copyright (c) 2026 STMicroelectronics.
  * All rights reserved.
  *
  * This software is licensed under terms that can be found in the LICENSE file
  * in the root directory of this software component.
  * If no LICENSE file comes with this software, it is provided AS-IS.
  *
  ******************************************************************************
  */
/* USER CODE END Header */

/* USER CODE BEGIN Includes */
/* Includes ------------------------------------------------------------------*/
#include "main.h"
#include "uart.h"
#include "pwm.h"
#include "adc.h"
#include "i2c.h"
#include <stdio.h>
/* Private includes ----------------------------------------------------------*/
/* USER CODE END Includes */

/* USER CODE BEGIN PV */
 volatile uint32_t background_counter = 0;
 volatile uint32_t button_press_count = 0;
 volatile uint32_t ms_ticks = 0;
/* USER CODE END PV */

/* USER CODE BEGIN PFP */
 /* Private function prototypes -----------------------------------------------*/
 void SystemClock_Config(void);
 static void MX_GPIO_Init(void);
 void My_SysTick_Init_1ms(void);
 void my_delay_ms(uint32_t delay);
/* USER CODE END PFP */

int main(void)
{

  /* Reset of all peripherals, Initializes the Flash interface and the Systick. */
  HAL_Init();
  /* MCU Configuration--------------------------------------------------------*/
  /* Configure the system clock */
  SystemClock_Config();
  /* USER CODE BEGIN Init */
  My_SysTick_Init_1ms();
  USART2_Init();
  ADC1_Init();
  I2C1_Init();
  for (uint8_t a = 0x08; a < 0x78; a++)
  {
      if (I2C1_Probe(a) == I2C_OK)
          printf("Composant I2C trouve a 0x%02X\r\n", a);
  }
  /* USER CODE END Init */

  /* USER CODE BEGIN SysInit */

  TIM2_PWM_Init();
  /* USER CODE END SysInit */

  /* Initialize all configured peripherals */
  MX_GPIO_Init();
  /* USER CODE BEGIN 2 */
  RCC->AHB2ENR |= (1U << 2);   //active l'horloge sur PC13
  GPIOC->MODER &= ~(3U << 13*2);  // mettre le port en entree
    /* USER CODE END 2 */

  /* Infinite loop */
  /* USER CODE BEGIN WHILE */
    //uint32_t last_toggle_time = 0;

  while (1)
  {
	  uint16_t raw_value = ADC1_read();
	  // Calcul en millivolts : (raw_value * 3300) / 4095
	  uint32_t adc_value = (raw_value*3300)/4095;
	  uint32_t pwm_value = (raw_value*999)/4095;
	  TIM2->CCR1 = pwm_value;
	  //printf("ADC Raw: %4u | Tension: %lu mV (%lu.%02lu V) | PWM value: %lu\r\n",
	    //         raw_value, adc_value, adc_value / 1000, (adc_value % 1000) / 10, pwm_value);
	  //my_delay_ms(250);
	  if (I2C1_WriteByte(0x27, 0x08) != I2C_OK)
	      printf("Erreur I2C\r\n");
	  if (I2C1_WriteByte(LCD_ADDR, 0x00) != I2C_OK)   // rétroéclairage éteint
	      printf("Erreur I2C (OFF)\r\n");
	  my_delay_ms(250);

	  if (I2C1_WriteByte(LCD_ADDR, 0x08) != I2C_OK)   // rétroéclairage allumé
	      printf("Erreur I2C (ON)\r\n");
	  my_delay_ms(250);
    /* USER CODE END WHILE */

	  /* USER CODE BEGIN 3*/

  }
  /* USER CODE END 3 */
}

static void MX_GPIO_Init(void)
{
  GPIO_InitTypeDef GPIO_InitStruct = {0};

  /* GPIO Ports Clock Enable */
  __HAL_RCC_GPIOB_CLK_ENABLE();
  __HAL_RCC_GPIOA_CLK_ENABLE();

  /*Configure GPIO pin Output Level */
  HAL_GPIO_WritePin(GPIOB, GPIO_PIN_13, GPIO_PIN_RESET);

  /*Configure GPIO pin : PB13 */
  GPIO_InitStruct.Pin = GPIO_PIN_13;
  GPIO_InitStruct.Mode = GPIO_MODE_OUTPUT_PP;
  GPIO_InitStruct.Pull = GPIO_NOPULL;
  GPIO_InitStruct.Speed = GPIO_SPEED_FREQ_LOW;
  HAL_GPIO_Init(GPIOB, &GPIO_InitStruct);

}

/* USER CODE BEGIN 4 */
void My_SysTick_Init_1ms (void)
{
	SysTick->LOAD = (16000000/1000) - 1; // 15999
	SysTick->VAL = 0;   			// Remet le compteur à zéro
	SysTick->CTRL |= (7U << 0);		// 0x07: Core Clock + Interrupt + Enable
}

/*
void SysTick_Handler (void)
{
	ms_ticks++;			// Chaque passage ici = exactement 1 ms écoulée
}
*/
void my_delay_ms(uint32_t delay)
{
	uint32_t start = ms_ticks;
	while ((ms_ticks - start) < delay)
	{
		// On attend que les interruptions SysTick fassent monter ms_ticks
	}
}

/**
  * @brief System Clock Configuration
  * @retval None
  */
void SystemClock_Config(void)
{
  RCC_OscInitTypeDef RCC_OscInitStruct = {0};
  RCC_ClkInitTypeDef RCC_ClkInitStruct = {0};

  /** Configure the main internal regulator output voltage
  */
  HAL_PWREx_ControlVoltageScaling(PWR_REGULATOR_VOLTAGE_SCALE1);

  /** Initializes the RCC Oscillators according to the specified parameters
  * in the RCC_OscInitTypeDef structure.
  */
  RCC_OscInitStruct.OscillatorType = RCC_OSCILLATORTYPE_HSI;
  RCC_OscInitStruct.HSIState = RCC_HSI_ON;
  RCC_OscInitStruct.HSICalibrationValue = RCC_HSICALIBRATION_DEFAULT;
  RCC_OscInitStruct.PLL.PLLState = RCC_PLL_NONE;
  if (HAL_RCC_OscConfig(&RCC_OscInitStruct) != HAL_OK)
  {
    Error_Handler();
  }

  /** Initializes the CPU, AHB and APB buses clocks
  */
  RCC_ClkInitStruct.ClockType = RCC_CLOCKTYPE_HCLK|RCC_CLOCKTYPE_SYSCLK
                              |RCC_CLOCKTYPE_PCLK1|RCC_CLOCKTYPE_PCLK2;
  RCC_ClkInitStruct.SYSCLKSource = RCC_SYSCLKSOURCE_HSI;
  RCC_ClkInitStruct.AHBCLKDivider = RCC_SYSCLK_DIV1;
  RCC_ClkInitStruct.APB1CLKDivider = RCC_HCLK_DIV1;
  RCC_ClkInitStruct.APB2CLKDivider = RCC_HCLK_DIV1;

  if (HAL_RCC_ClockConfig(&RCC_ClkInitStruct, FLASH_LATENCY_0) != HAL_OK)
  {
    Error_Handler();
  }
}

/* USER CODE END 4 */

void Error_Handler(void)
{
  __disable_irq();
  while (1)
  {
  }
}
